## hub/main/Kconfig.projbuild
```kconfig
# AIO Feeder hub — build-time options (menuconfig: "AIO Feeder hub").
menu "AIO Feeder hub"

    config AIO_WIFI_SSID
        string "Wi-Fi SSID (empty = no Wi-Fi, RTC-only time)"
        default ""
        help
            When set, the hub joins this network at boot and enables SNTP
            (pool.ntp.org). Leave empty for bench/QEMU use.

    config AIO_WIFI_PASS
        string "Wi-Fi password"
        default ""

    config AIO_RTC_SDA
        int "I2C SDA GPIO for the onboard PCF85063"
        default 8
        help
            Waveshare ESP32-S3-Touch-LCD-4.3B: touch/RTC I2C bus is GPIO8/9.

    config AIO_RTC_SCL
        int "I2C SCL GPIO for the onboard PCF85063"
        default 9

    config AIO_SD_CLK
        int "SD card CLK GPIO (SDMMC 1-bit)"
        default 12
        help
            Waveshare ESP32-S3-Touch-LCD-4.3B microSD slot: the FPC wires
            card CLK to GPIO12 (labeled SCK in the wiki's SPI table), card
            CMD to GPIO11 (labeled MOSI) and card DAT0 to GPIO13 (labeled
            MISO); DAT3/CS rides CH422G EXIO4, held high for SD mode by
            display_hw.cpp (D35). Verify against the schematic before
            relying on it [VERIFY].

    config AIO_SD_CMD
        int "SD card CMD GPIO"
        default 11

    config AIO_SD_D0
        int "SD card D0 GPIO (1-bit mode)"
        default 13

    config AIO_NO_RADIO
        bool "Skip ESP-NOW/Wi-Fi bring-up entirely (QEMU smoke build)"
        default n
        help
            The QEMU machine model has no Wi-Fi peripheral; a hung or
            panicking esp_wifi init would break the CI boot smoke. The qemu
            sdkconfig overlay enables this; the hub then runs core+console.

    config AIO_UI_SHOT
        bool "UI screenshot mode: sim nodes + offscreen LVGL + AIO_SHOT markers"
        default n
        depends on AIO_NO_RADIO
        help
            QEMU build for the M4a screenshot run: wall clock pinned to a
            fixed Sunday morning, two sim nodes on a loopback link (real
            LinkEngine node role, real frames), and the LVGL dashboard
            rendering into a static 384x240 framebuffer. tools/qemu/
            capture.py dumps the framebuffer via the QEMU monitor
            'pmemsave' after each "AIO_SHOT" marker and writes PNGs.

    config AIO_HW_DISPLAY
        bool "Drive the Waveshare 4.3B RGB panel + GT911 touch (hardware UI)"
        default y
        depends on !AIO_UI_SHOT
        help
            Brings up the ST7262 RGB panel (800x480, plain RGB, 16 MHz
            PCLK), the CH422G expander (LCD_RST/TP_RST/backlight/SD_CS) and
            the GT911 touch controller on the shared I2C bus, and feeds the
            LVGL UI (logical 352x240, 2x expand into the 704x480 window).
            The QEMU shot build implies this is off (depends on
            !AIO_UI_SHOT); a display failure is reported and the hub keeps
            running headless (feeding never depends on the UI, PLAN.md
            3.3).

    config AIO_OTA_CONFIRM_MS
        int "OTA health-confirm window (ms) before marking a new image valid"
        default 300000
        help
            After an update reboots into the staged slot the image sits in
            PENDING_VERIFY; once the hub loop has run healthy for this long
            ota_service calls esp_ota_mark_app_valid_cancel_rollback(). A
            crash-looping image never confirms and the bootloader rolls
            back. The QEMU OTA selftest overlay shortens this to seconds.

    config AIO_OTA_SELFTEST
        bool "QEMU OTA selftest driver (stage/copy/rollback boot walk)"
        default n
        depends on AIO_NO_RADIO
        help
            CI-only boot walk for the M8a OTA path (tools/qemu/badapp +
            tools/qemu/ota_run.py): boots 1) stage a copy of the running
            image into ota_0, 2) confirm it via the health window, 3) stage
            the badapp partition into ota_1, 4) watch the bootloader
            invalidate the never-confirming image and fall back. Requires
            the flash image to carry a "badapp" partition (partitions.csv)
            and CONFIG_BOOTLOADER_APP_ROLLBACK_ENABLE.

endmenu
```
